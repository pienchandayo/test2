## boards/shields/my_kb/Kconfig.defconfig
```kconfig
if SHIELD_MY_KB

# Name must be less than 16 characters long!
config ZMK_KEYBOARD_NAME
    default "My Keyboard"
# マウス機能の有効化
CONFIG_ZMK_MOUSE=y
CONFIG_ZMK_POINTING=y
CONFIG_ZMK_INPUT=y

# ログ出力（デバッグ用）
CONFIG_ZMK_USB_LOGGING=y

# Bluetooth関連
CONFIG_BT_PERIPHERAL=y
CONFIG_BT_DEVICE_NAME="My Mouse Keyboard"
endif
```

## boards/shields/my_keyboard/Kconfig.defconfig
```kconfig
if SHIELD_MY_KEYBOARD

# Name must be less than 16 characters long!
config ZMK_KEYBOARD_NAME
    default "My Keyboard"
# ここにマウス設定を念押しで入れる
config ZMK_MOUSE
    default y

config ZMK_INPUT
    default y

endif
```

## config/west.yml
```yaml
manifest:
  remotes:
    - name: zmkfirmware
      url-base: https://github.com/zmkfirmware
    - name: badjeff
      url-base: https://github.com/badjeff
    - name: oleksandrmaslov
      url-base: https://github.com/oleksandrmaslov      

  projects:
    - name: zmk
      remote: zmkfirmware
      revision: main
      import: app/west.yml
    - name: zmk-analog-input-driver
      remote: badjeff
      revision: main
    - name: zmk-pointing-acceleration
      remote: oleksandrmaslov
      revision: main
  self:
    path: config
```
